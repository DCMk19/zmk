## app/boards/shields/gbprsnll/Kconfig.defconfig
```kconfig
# Copyright (c) 2020 The ZMK Contributors
# SPDX-License-Identifier: MIT

if SHIELD_GBPRSNLL

config ZMK_KEYBOARD_NAME
    default "GameBuddy"

endif
```

## app/boards/shields/gbpsef/Kconfig.defconfig
```kconfig
# Copyright (c) 2020 The ZMK Contributors
# SPDX-License-Identifier: MIT

if SHIELD_GAMEBUDDY_LEFT

config ZMK_KEYBOARD_NAME
    default "GameBuddy Left"

config ZMK_SPLIT_BLE_ROLE_CENTRAL
    default y

endif

if SHIELD_GAMEBUDDY_RIGHT

config ZMK_KEYBOARD_NAME
    default "GameBuddy Right"

endif

if SHIELD_GAMEBUDDY_LEFT || SHIELD_GAMEBUDDY_RIGHT

config ZMK_SPLIT
    default y

endif
```

## app/boards/shields/gbpsef/Kconfig.shield
```kconfig
# Copyright (c) 2020 The ZMK Contributors
# SPDX-License-Identifier: MIT

config SHIELD_GAMEBUDDY_LEFT
	def_bool $(shields_list_contains,gamebuddy_left)

config SHIELD_GAMEBUDDY_RIGHT
	def_bool $(shields_list_contains,gamebuddy_right)	
```

## app/boards/shields/gbrmedia/Kconfig.defconfig
```kconfig
# Copyright (c) 2020 The ZMK Contributors
# SPDX-License-Identifier: MIT

if SHIELD_GBRMEDIA

config ZMK_KEYBOARD_NAME
    default "GameBuddy Media"

endif
```

## app/boards/shields/gbrmedia/Kconfig.shield
```kconfig
# Copyright (c) 2020 The ZMK Contributors
# SPDX-License-Identifier: MIT

config SHIELD_GBRMEDIA
	def_bool $(shields_list_contains,gbrmedia)
```

## app/boards/shields/reviung41lp/Kconfig.defconfig
```kconfig
# Copyright (c) 2020 The ZMK Contributors
# SPDX-License-Identifier: MIT

if SHIELD_REVIUNG41LP

config ZMK_KEYBOARD_NAME
    default "Reviung41LP"

endif
```
