/*
 * Copyright (c) 2020 The ZMK Contributors
 *
 * SPDX-License-Identifier: MIT
 */

#include "gbpsef.dtsi" 

&default_transform {
    col-offset = <7>;
};

&kscan0 {
    col-gpios
        = <&pro_micro_d 6 GPIO_ACTIVE_HIGH> 
        , <&pro_micro_d 5 GPIO_ACTIVE_HIGH> 
        , <&pro_micro_d 4 GPIO_ACTIVE_HIGH> 
        , <&pro_micro_d 3 GPIO_ACTIVE_HIGH> 
        , <&pro_micro_d 14 GPIO_ACTIVE_HIGH> 
        , <&pro_micro_d 16 GPIO_ACTIVE_HIGH>
        , <&pro_micro_d 9 GPIO_ACTIVE_HIGH> 
        ;
};